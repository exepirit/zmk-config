## boards/shields/koda/Kconfig.defconfig
```kconfig
if SHIELD_KODA

config ZMK_KEYBOARD_NAME
    default "Koda"

CONFIG_BT_GATT_ENFORCE_SUBSCRIPTION=n
CONFIG_ZMK_PM_SOFT_OFF=y
CONFIG_ZMK_SLEEP=y

endif
```
